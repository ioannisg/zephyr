## arch/arm/soc/nordic_nrf5/nrf5cm33/Kconfig.defconfig.nrf5cm33_QFAA
```kconfig
# Kconfig.defconfig.nrf52832 - Nordic Semiconductor nRF5cm33 MCU
#
# Copyright (c) 2016 Nordic Semiconductor ASA
#
# SPDX-License-Identifier: Apache-2.0
#


if SOC_NRF5CM33_QFAA

config SOC
	string
	default nRF5CM33_QFAA

config NUM_IRQS
	int
	default 39

endif # SOC_NRF5CM33_QFAA
```

## arch/arm/soc/nordic_nrf5/nrf5cm33/Kconfig.defconfig.series
```kconfig
# Kconfig.defconfig.series - Nordic Semiconductor nRF5 MCU line
#
# Copyright (c) 2016 Nordic Semiconductor ASA
#
# SPDX-License-Identifier: Apache-2.0
#

if SOC_SERIES_NRF5CM33X

source "arch/arm/soc/nordic_nrf5/nrf5cm33/Kconfig.defconfig.nrf5cm33*"

config SOC_SERIES
	default nrf5cm33

config SYS_CLOCK_HW_CYCLES_PER_SEC
	int
	default 32768

config SYS_POWER_MANAGEMENT
	default y

endif # SOC_SERIES_NRF5CM33X
```

## arch/arm/soc/nordic_nrf5/nrf5cm33/Kconfig.series
```kconfig
# Kconfig.series - Nordic Semiconductor nRF5 MCU line
#
# Copyright (c) 2016 Nordic Semiconductor ASA
#
# SPDX-License-Identifier: Apache-2.0
#

config  SOC_SERIES_NRF5CM33X
	bool "Nordic Semiconductor nRF5CM33 series MCU: experimental Cortex-M33 emulator"
	select CPU_CORTEX_M
	select CPU_CORTEX_M33
	select CPU_HAS_MPU
	select SOC_FAMILY_NRF5
	select NRF_RTC_TIMER
	select CLOCK_CONTROL
	select CLOCK_CONTROL_NRF5
	select SYS_POWER_LOW_POWER_STATE_SUPPORTED
	select SYS_POWER_DEEP_SLEEP_SUPPORTED
	select XIP
	select HAS_CMSIS
	select HAS_NRFX
	help
	 Enable support for NRF5CM33 MCU series
```

## arch/arm/soc/nordic_nrf5/nrf5cm33/Kconfig.soc
```kconfig
# Kconfig.soc - Nordic Semiconductor nRF5CM33 MCU line
#
# Copyright (c) 2016 Nordic Semiconductor ASA
#
# SPDX-License-Identifier: Apache-2.0
#

config SOC_NRF5CM33
	depends on SOC_SERIES_NRF5CM33X
	bool

choice
prompt "nRF5CM33x MCU Selection"
depends on SOC_SERIES_NRF5CM33X

config SOC_NRF5CM33_QFAA
	bool "NRF5CM33_QFAA"
	select SOC_NRF5CM33

endchoice
```

## boards/arm/mps2_an386/Kconfig.board
```kconfig
# Copyright (c) 2020 Linaro Limited
# SPDX-License-Identifier: Apache-2.0

config BOARD_MPS2_AN386
	bool "ARM Cortex-M4 SMM on V2M-MPS2 (Application Note AN386)"
	depends on SOC_MPS2_AN386
	select HAS_COVERAGE_SUPPORT
```

## boards/arm/nrf5340_dk_nrf5340/Kconfig
```kconfig
# nRF5340 DK NRF5340 board configuration

# Copyright (c) 2019 Nordic Semiconductor ASA
# SPDX-License-Identifier: Apache-2.0

if BOARD_NRF5340_DK_NRF5340_CPUAPP || BOARD_NRF5340_DK_NRF5340_CPUAPPNS

choice BT_HCI_BUS_TYPE
	default BT_NRF_OPEN_AMP if BT
endchoice

config HEAP_MEM_POOL_SIZE
	default 8192 if BT_NRF_OPEN_AMP

# When BT is enabled we should default to also
# enabling the Vendor Specific commands.
config BT_HAS_HCI_VS
	default y if BT

endif # BOARD_NRF5340_DK_NRF5340_CPUAPP || BOARD_NRF5340_DK_NRF5340_CPUAPPNS

if BOARD_NRF5340_DK_NRF5340_CPUNET

# BT_CTLR depends on BT. When BT is enabled we should default to also
# enabling the controller.
config BT_CTLR
	default y if BT

config BT_ECC
	default y if BT

endif # BOARD_NRF5340_DK_NRF5340_CPUNET
```

## boards/arm/nrf5340_pca10095/Kconfig
```kconfig
# Kconfig - nRF5340 PCA10095 board configuration
#
# Copyright (c) 2019 Nordic Semiconductor ASA
#
# SPDX-License-Identifier: Apache-2.0

if BOARD_NRF5340_PCA10095_CPU0 || BOARD_NRF5340_PCA10095_CPU0NS

endif # BOARD_NRF5340_PCA10095_CPU0 || BOARD_NRF5340_PCA10095_CPU0NS

if BOARD_NRF5340_PCA10095_CPU1

# BT_CTLR depends on BT. When BT is enabled we should default to also
# enabling the controller.
config BT_CTLR
	default y if BT

endif # BOARD_NRF5340_PCA10095_CPU1
```

## boards/arm/nrf5340_pca10095/Kconfig.board
```kconfig
# Kconfig - nRF5340 PCA10095 board configuration
#
# Copyright (c) 2019 Nordic Semiconductor ASA
#
# SPDX-License-Identifier: Apache-2.0

if SOC_NRF5340_CPU0_QKAA

config BOARD_NRF5340_PCA10095_CPU0
	bool "nRF5340 PCA10095 Application MCU"

config BOARD_NRF5340_PCA10095_CPU0NS
	bool "nRF5340 PCA10095 Application MCU non-secure"

endif # SOC_NRF5340_CPU0_QKAA


if SOC_NRF5340_CPU1_QKAA

config BOARD_NRF5340_PCA10095_CPU1
	bool "nRF5340 PCA10095 Network MCU"

endif # SOC_NRF5340_CPU1_QKAA
```

## boards/arm/nrf5340_pca10095/Kconfig.defconfig
```kconfig
# Kconfig - nRF5340 PCA10095 board configuration
#
# Copyright (c) 2019 Nordic Semiconductor ASA
#
# SPDX-License-Identifier: Apache-2.0

if BOARD_NRF5340_PCA10095_CPU0 || BOARD_NRF5340_PCA10095_CPU0NS

config BOARD
	default "nrf5340_pca10095_application_mcu"

if ADC

config ADC_0
	default y

endif # ADC

if I2C

config I2C_1
	default y

endif # I2C

if PWM

config PWM_0
	default y

endif # PWM

if SPI

config SPI_2
	default y

endif # SPI

# For the secure version of the board the firmware is linked at the beginning
# of the flash, or into the code-partition defined in DT if it is intended to
# be loaded by MCUboot. If the secure firmware is to be combined with a non-
# secure image (TRUSTED_EXECUTION_SECURE=y), the secure FW image shall always
# be restricted to the size of its code partition.
# For the non-secure version of the board, the firmware
# must be linked into the code-partition (non-secure) defined in DT, regardless.
# Apply this configuration below by setting the Kconfig symbols used by
# the linker according to the information extracted from DT partitions.

# Workaround for not being able to have commas in macro arguments
DT_CHOSEN_Z_CODE_PARTITION := zephyr,code-partition

if BOARD_NRF5340_PCA10095_CPU0 && TRUSTED_EXECUTION_SECURE

config FLASH_LOAD_SIZE
	default $(dt_chosen_reg_size_hex,$(DT_CHOSEN_Z_CODE_PARTITION))

endif # BOARD_NRF5340_PCA10095_CPU0 && TRUSTED_EXECUTION_SECURE

if BOARD_NRF5340_PCA10095_CPU0NS

config FLASH_LOAD_OFFSET
	default $(dt_chosen_reg_addr_hex,$(DT_CHOSEN_Z_CODE_PARTITION))

config FLASH_LOAD_SIZE
	default $(dt_chosen_reg_size_hex,$(DT_CHOSEN_Z_CODE_PARTITION))

endif # BOARD_NRF5340_PCA10095_CPU0NS

endif # BOARD_NRF5340_PCA10095_CPU0 || BOARD_NRF5340_PCA10095_CPU0NS
```

## boards/arm/nrf5cm33_emu/Kconfig.board
```kconfig
# Kconfig - nRF5CM33 EMU board configuration
#
# Copyright (c) 2018 Nordic Semiconductor ASA
#
# SPDX-License-Identifier: Apache-2.0

config  BOARD_NRF5CM33_EMU
	bool "nRF5CM33 EMU"
	depends on SOC_NRF5CM33_QFAA
```

## boards/arm/nrf5cm33_emu/Kconfig.defconfig
```kconfig
# Kconfig - nRF5CM33 EMU board configuration
#
# Copyright (c) 2018 Nordic Semiconductor ASA
#
# SPDX-License-Identifier: Apache-2.0

if BOARD_NRF5CM33_EMU

config BOARD
	default nrf5cm33_emu

if GPIO_NRF5

config GPIO_NRF5_P0
	default y

endif # GPIO_NRF5

if UART_NRF5

config UART_NRF5_GPIO_TX_PIN
	default 6

config UART_NRF5_GPIO_RX_PIN
	default 8

config UART_NRF5_GPIO_RTS_PIN
	default 5

config UART_NRF5_GPIO_CTS_PIN
	default 7

endif # UART_NRF5

endif # BOARD_NRF5CM33_EMU
```

## boards/arm/nrf5cm33_emu/nrf5cm33_emu_defconfig
```kconfig
CONFIG_ARM=y
CONFIG_SOC_FAMILY_NRF5=y
CONFIG_SOC_SERIES_NRF5CM33X=y
CONFIG_SOC_NRF5CM33_QFAA=y
CONFIG_BOARD_NRF5CM33_EMU=y

# enable uart driver
CONFIG_SERIAL=y
CONFIG_UART_NRF5=y

# enable console
CONFIG_CONSOLE=y
CONFIG_UART_CONSOLE=y
```

## boards/arm/nrf9160_pca10090/Kconfig.defconfig
```kconfig
# Kconfig - nRF91 PCA10090 board configuration
#
# Copyright (c) 2018 Nordic Semiconductor ASA
#
# SPDX-License-Identifier: Apache-2.0

if BOARD_NRF9160_PCA10090

config BOARD
	default "nrf9160_pca10090"

if ADC

config ADC_0
	default y

endif # ADC

if I2C

config I2C_0
	default y

endif # I2C

if SPI

config SPI_1
	default y

endif # SPI

endif # BOARD_NRF9160_PCA10090
```

## boards/arm/pfm_m2351/Kconfig.board
```kconfig
# Kconfig - nRF51 PCA10028 board configuration
#
# Copyright (c) 2016 Linaro Limited.
#
# SPDX-License-Identifier: Apache-2.0

config BOARD_PFM_M2351
	bool "PFM M2351"
	depends on SOC_M2351_KIAAE
```

## boards/arm/pfm_m2351/Kconfig.defconfig
```kconfig
# Kconfig - PMF M2351 board configuration
#
# Copyright (c) 2016 Linaro Limited.
#
# SPDX-License-Identifier: Apache-2.0

if BOARD_PFM_M2351

config BOARD
	default "pfm_m2351"

endif # BOARD_PFM_M2351
```

## boards/arm/pfm_m2351/pfm_m2351_defconfig
```kconfig
# SPDX-License-Identifier: Apache-2.0

CONFIG_ARM=y
CONFIG_SOC_FAMILY_NUVOTON=y
CONFIG_SOC_SERIES_M2351X=y
CONFIG_SOC_M2351_KIAAE=y
CONFIG_BOARD_PFM_M2351=y

# enable uart driver
CONFIG_SERIAL=y

# enable console
CONFIG_CONSOLE=y
CONFIG_UART_CONSOLE=y

CONFIG_CORTEX_M_SYSTICK=y
```

## drivers/ipm/Kconfig.nrfx
```kconfig
# nRF IPM driver configuration

# Copyright (c) 2019 Nordic Semiconductor ASA
# SPDX-License-Identifier: Apache-2.0

if IPM_NRFX

nrfx_ipc_num = 0
source "drivers/ipm/Kconfig.nrfx_ipc_channel"
nrfx_ipc_num = 1
source "drivers/ipm/Kconfig.nrfx_ipc_channel"
nrfx_ipc_num = 2
source "drivers/ipm/Kconfig.nrfx_ipc_channel"
nrfx_ipc_num = 3
source "drivers/ipm/Kconfig.nrfx_ipc_channel"
nrfx_ipc_num = 4
source "drivers/ipm/Kconfig.nrfx_ipc_channel"
nrfx_ipc_num = 5
source "drivers/ipm/Kconfig.nrfx_ipc_channel"
nrfx_ipc_num = 6
source "drivers/ipm/Kconfig.nrfx_ipc_channel"
nrfx_ipc_num = 7
source "drivers/ipm/Kconfig.nrfx_ipc_channel"
nrfx_ipc_num = 8
source "drivers/ipm/Kconfig.nrfx_ipc_channel"
nrfx_ipc_num = 9
source "drivers/ipm/Kconfig.nrfx_ipc_channel"
nrfx_ipc_num = 10
source "drivers/ipm/Kconfig.nrfx_ipc_channel"
nrfx_ipc_num = 11
source "drivers/ipm/Kconfig.nrfx_ipc_channel"
nrfx_ipc_num = 12
source "drivers/ipm/Kconfig.nrfx_ipc_channel"
nrfx_ipc_num = 13
source "drivers/ipm/Kconfig.nrfx_ipc_channel"
nrfx_ipc_num = 14
source "drivers/ipm/Kconfig.nrfx_ipc_channel"
nrfx_ipc_num = 15
source "drivers/ipm/Kconfig.nrfx_ipc_channel"


endif #IPM_NRFX
```

## drivers/ipm/Kconfig.nrfx_ipc_channel
```kconfig
# nRF IPM driver channel configuration

# Copyright (c) 2019 Nordic Semiconductor ASA
# SPDX-License-Identifier: Apache-2.0

menu "IPM Message Channel [$(nrfx_ipc_num)] configuration"

config IPM_MSG_CH_$(nrfx_ipc_num)_ENABLE
	bool "Enable IPM Message Channel $(nrfx_ipc_num)"

choice
	prompt "IPM Message Channel $(nrfx_ipc_num) direction"
	default IPM_MSG_CH_$(nrfx_ipc_num)_RX
	depends on IPM_MSG_CH_$(nrfx_ipc_num)_ENABLE

config IPM_MSG_CH_$(nrfx_ipc_num)_RX
	bool "RX"

config IPM_MSG_CH_$(nrfx_ipc_num)_TX
	bool "TX"

endchoice

endmenu
```

## soc/arm/arm/mps2/Kconfig.defconfig.mps2_an386
```kconfig
# Copyright (c) 2017 Linaro Limited
# SPDX-License-Identifier: Apache-2.0

if SOC_MPS2_AN386

config SOC
	default "mps2_an386"

config NUM_IRQS
	default 32

endif
```

## soc/arm/nordic_nrf/nrf53/Kconfig.defconfig.nrf5340_CPU0_QKAA
```kconfig
# Kconfig.defconfig.nrf5340 - Nordic Semiconductor nRF5340 Application MCU
#
# Copyright (c) 2019 Nordic Semiconductor ASA
#
# SPDX-License-Identifier: Apache-2.0
#


if SOC_NRF5340_CPU0_QKAA

config SOC
	default "nRF5340_CPU0_QKAA"

config NUM_IRQS
	default 69

endif # SOC_NRF5340_CPU0_QKAA
```

## soc/arm/nordic_nrf/nrf53/Kconfig.defconfig.nrf5340_CPU1_QKAA
```kconfig
# Kconfig.defconfig.nrf5340 - Nordic Semiconductor nRF5340 Network MCU
#
# Copyright (c) 2019 Nordic Semiconductor ASA
#
# SPDX-License-Identifier: Apache-2.0
#


if SOC_NRF5340_CPU1_QKAA

config SOC
	default "nRF5340_CPU1_QKAA"

config NUM_IRQS
	default 30

endif # SOC_NRF5340_CPU1_QKAA
```

## soc/arm/nuvoton/Kconfig
```kconfig
# Kconfig - Nuvoton M2351 MCU line
#
# Copyright (c) 2016-2018 Nordic Semiconductor ASA
#
# SPDX-License-Identifier: Apache-2.0
#

config SOC_FAMILY_NUVOTON
	bool
	# omit prompt to signify a "hidden" option

if SOC_FAMILY_NUVOTON
config SOC_FAMILY
	string
	default "nuvoton"

source "soc/arm/nuvoton/*/Kconfig.soc"

endif # SOC_FAMILY_NUVOTON
```

## soc/arm/nuvoton/Kconfig.defconfig
```kconfig
# Kconfig.defconfig - Nuvoton M2351 MCU line
#
# Copyright (c) 2016-2018 Nordic Semiconductor ASA
#
# SPDX-License-Identifier: Apache-2.0
#

if SOC_FAMILY_NUVOTON

source "soc/arm/nuvoton/*/Kconfig.defconfig.series"

config BUILD_OUTPUT_HEX
	default y

endif # SOC_FAMILY_NRF
```

## soc/arm/nuvoton/Kconfig.soc
```kconfig
# Kconfig.soc - Nordic Semiconductor nRFx MCU line
#
# Copyright (c) 2016-2018 Nordic Semiconductor ASA
#
# SPDX-License-Identifier: Apache-2.0
#

source "soc/arm/nuvoton/*/Kconfig.series"
```
