## soc/arm/nuvoton/m2351/Kconfig.defconfig.m2351_KIAAE
```kconfig
# Kconfig.defconfig.num2351 - Nuvoton M2351 MCU
#
# Copyright (c) 2016 Nordic Semiconductor ASA
#
# SPDX-License-Identifier: Apache-2.0
#

if SOC_M2351_KIAAE

config SOC
	string
	default "m2351_kiaae"

config SYS_CLOCK_HW_CYCLES_PER_SEC
	int
	default 64000000

config NUM_IRQS
	int
	default 26

endif # SOC_M2351_KIAAE
```

## soc/arm/nuvoton/m2351/Kconfig.defconfig.series
```kconfig
# Kconfig.defconfig.series - Nuvoton M23 MCU line
#
# Copyright (c) 2018 Nordic Semiconductor ASA
#
# SPDX-License-Identifier: Apache-2.0
#

if SOC_SERIES_M2351X

source "soc/arm/nuvoton/m2351/Kconfig.defconfig.m2351*"

config SOC_SERIES
	default "m2351"


endif # SOC_SERIES_M2351X
```

## soc/arm/nuvoton/m2351/Kconfig.series
```kconfig
# Kconfig.series - Nuvoton M23 MCU line
#
# Copyright (c) 2018 Nordic Semiconductor ASA
#
# SPDX-License-Identifier: Apache-2.0
#

config  SOC_SERIES_M2351X
	bool "Nuvoton M2351 series MCU"
	select SOC_FAMILY_NUVOTON
	select CPU_CORTEX_M23
	select CPU_CORTEX_M_HAS_SYSTICK
	select CPU_CORTEX_M_HAS_VTOR
	select CPU_HAS_MPU
	select XIP
	select HAS_CMSIS
	help
	  Enable support for Nuvoton M2351 MCU series
```

## soc/arm/nuvoton/m2351/Kconfig.soc
```kconfig
# Kconfig.soc - Nuvoton M23 MCU line
#
# Copyright (c) 2016 Nordic Semiconductor ASA
#
# SPDX-License-Identifier: Apache-2.0
#

choice
prompt "Nuvoton M23x MCU Selection"
depends on SOC_SERIES_M2351X

config SOC_M2351_KIAAE
	bool "M2351_KIAAE"

endchoice
```
